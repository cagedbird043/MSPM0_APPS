/**
 * @cliArgs --board "/ti/boards/LP_MSPM0G3507" --product "mspm0_sdk@2.05.01.00"
 * @versions {"tool":"1.24.1+4189"}
 */

/**
 * Import the modules used in this configuration.
 */
const GPIO   = scripting.addModule("/ti/driverlib/GPIO", {}, false);
const GPIO1  = GPIO.addInstance();
const TIMER  = scripting.addModule("/ti/driverlib/TIMER", {}, false);
const TIMER1 = TIMER.addInstance();

/**
 * Write custom configuration values to the imported modules.
 */
GPIO1.$name                               = "GPIO_GRP_0";
GPIO1.associatedPins[0].$name             = "USER_LED_1";
GPIO1.associatedPins[0].launchPadShortcut = "LED1En";

const Board = scripting.addModule("/ti/driverlib/Board", {}, false);

const SYSCTL = scripting.addModule("/ti/driverlib/SYSCTL", {}, false);

TIMER1.$name            = "TIMER_0";
TIMER1.timerMode        = "PERIODIC";
TIMER1.interrupts       = ["ZERO"];
TIMER1.timerClkPrescale = 256;
TIMER1.timerPeriod      = "500ms";

/**
 * Pinmux solution for unlocked pins/peripherals. This ensures that minor changes to the automatic solver in a future
 * version of the tool will not impact the pinmux you originally saw.  These lines can be completely deleted in order to
 * re-solve from scratch.
 */
GPIO1.associatedPins[0].pin.$suggestSolution = "j19_expansion.9";
Board.peripheral.$suggestSolution            = "DEBUGSS";
Board.peripheral.swclkPin.$suggestSolution   = "j25_expansion.16";
Board.peripheral.swdioPin.$suggestSolution   = "j25_expansion.14";
SYSCTL.peripheral.$suggestSolution           = "SYSCTL";
TIMER1.peripheral.$suggestSolution           = "TIMA0";
