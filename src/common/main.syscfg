/**
 * @cliArgs --board "/ti/boards/LP_MSPM0G3507" --product "mspm0_sdk@2.05.01.00"
 * @versions {"tool":"1.24.1+4189"}
 */

/**
 * Import the modules used in this configuration.
 */
const PWM    = scripting.addModule("/ti/driverlib/PWM", {}, false);
const PWM1   = PWM.addInstance();
const TIMER  = scripting.addModule("/ti/driverlib/TIMER", {}, false);
const TIMER1 = TIMER.addInstance();

/**
 * Write custom configuration values to the imported modules.
 */
PWM1.timerStartTimer                    = true;
PWM1.$name                              = "PWM_TURRET";
PWM1.clockPrescale                      = 64;
PWM1.timerCount                         = 10000;
PWM1.pwmMode                            = "EDGE_ALIGN_UP";
PWM1.peripheral.ccp0Pin.$assign         = "boosterpack.15";
PWM1.peripheral.ccp1Pin.$assign         = "boosterpack.19";
PWM1.PWM_CHANNEL_0.$name                = "ti_driverlib_pwm_PWMTimerCC0";
PWM1.PWM_CHANNEL_0.invert               = true;
PWM1.PWM_CHANNEL_0.initVal              = "HIGH";
PWM1.PWM_CHANNEL_1.$name                = "ti_driverlib_pwm_PWMTimerCC1";
PWM1.PWM_CHANNEL_1.invert               = true;
PWM1.PWM_CHANNEL_1.initVal              = "HIGH";
PWM1.ccp0PinConfig.$name                = "ti_driverlib_gpio_GPIOPinGeneric0";
PWM1.ccp0PinConfig.direction            = scripting.forceWrite("OUTPUT");
PWM1.ccp0PinConfig.hideOutputInversion  = scripting.forceWrite(false);
PWM1.ccp0PinConfig.onlyInternalResistor = scripting.forceWrite(false);
PWM1.ccp0PinConfig.passedPeripheralType = scripting.forceWrite("Digital");
PWM1.ccp1PinConfig.$name                = "ti_driverlib_gpio_GPIOPinGeneric1";
PWM1.ccp1PinConfig.direction            = scripting.forceWrite("OUTPUT");
PWM1.ccp1PinConfig.hideOutputInversion  = scripting.forceWrite(false);
PWM1.ccp1PinConfig.onlyInternalResistor = scripting.forceWrite(false);
PWM1.ccp1PinConfig.passedPeripheralType = scripting.forceWrite("Digital");

const Board = scripting.addModule("/ti/driverlib/Board", {}, false);

const SYSCTL = scripting.addModule("/ti/driverlib/SYSCTL", {}, false);

TIMER1.$name            = "TIMER_MOTION";
TIMER1.timerMode        = "PERIODIC_UP";
TIMER1.timerClkPrescale = 32;
TIMER1.interrupts       = ["ZERO"];
TIMER1.timerPeriod      = "10 ms";

/**
 * Pinmux solution for unlocked pins/peripherals. This ensures that minor changes to the automatic solver in a future
 * version of the tool will not impact the pinmux you originally saw.  These lines can be completely deleted in order to
 * re-solve from scratch.
 */
PWM1.peripheral.$suggestSolution           = "TIMA0";
Board.peripheral.$suggestSolution          = "DEBUGSS";
Board.peripheral.swclkPin.$suggestSolution = "j25_expansion.16";
Board.peripheral.swdioPin.$suggestSolution = "j25_expansion.14";
SYSCTL.peripheral.$suggestSolution         = "SYSCTL";
TIMER1.peripheral.$suggestSolution         = "TIMA1";
